/*
 * pico_oled.h -- SSD1306 128x32 SPI status display (e.g. Adafruit 661).
 *
 * Driven from CORE 0 ONLY: a status panel is exactly the class of slow,
 * cosmetic peripheral the dual-core split parks on the housekeeping core.
 * Core 1 keeps a small snapshot current (single-writer volatiles in the main
 * .c); core 0 renders it a few times a second. A full frame is 512 bytes at
 * 8 MHz SPI ~= 0.5 ms, blocking, on core 0 -- invisible to the RT core, and
 * on a DEDICATED bus (SPI0), so unlike an I2C panel it can never delay an
 * ADS1115 sample.
 *
 * Runtime-enabled via `oled enable 1` + save/reboot (the ain_en pattern).
 * SSD1306-over-SPI is write-only (no MISO), so there is nothing to probe and
 * no failure to trip: with no display attached the writes go nowhere,
 * harmlessly. Pins (OLED_PIN_* in pico_gpio.h, reserved while enabled):
 * SPI0 SCK=GP2, MOSI=GP3, CS=GP6, DC=GP7, RST=GP8 -- see wiznet-io/PINMAP.md.
 *
 * Text grid: 21 cols x 4 rows (5x7 glyphs in 6x8 cells).
 */
#ifndef PICO_OLED_H
#define PICO_OLED_H

#include "hardware/spi.h"
#include "hardware/gpio.h"
#include "pico/stdlib.h"
#include "pico_gpio.h"          /* OLED_PIN_* */
#include <string.h>
#include <stdio.h>

#define OLED_SPI    spi0
#define OLED_BAUD   (8 * 1000 * 1000)
#define OLED_W      128
#define OLED_PAGES  4           /* 32 rows / 8 */
#define OLED_COLS   21          /* 128 / 6px text cells */
#define OLED_ROWS   4

static uint8_t oled_fb[OLED_W * OLED_PAGES];    /* 512B framebuffer */
static uint8_t oled_on;

/* Classic 5x7 font, ASCII 0x20..0x7E, column-major, LSB = top row. */
static const uint8_t oled_font[95][5] = {
    {0x00,0x00,0x00,0x00,0x00}, {0x00,0x00,0x5F,0x00,0x00}, {0x00,0x07,0x00,0x07,0x00},
    {0x14,0x7F,0x14,0x7F,0x14}, {0x24,0x2A,0x7F,0x2A,0x12}, {0x23,0x13,0x08,0x64,0x62},
    {0x36,0x49,0x55,0x22,0x50}, {0x00,0x05,0x03,0x00,0x00}, {0x00,0x1C,0x22,0x41,0x00},
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    {0x00,0x41,0x36,0x08,0x00}, {0x08,0x04,0x08,0x10,0x08},
};

static inline void oled_cmd(const uint8_t *c, int n)
{
    gpio_put(OLED_PIN_DC, 0);
    gpio_put(OLED_PIN_CS, 0);
    spi_write_blocking(OLED_SPI, c, (size_t) n);
    gpio_put(OLED_PIN_CS, 1);
}

static inline void oled_clear(void) { memset(oled_fb, 0, sizeof oled_fb); }

/* Write a string at (col,row) in the 21x4 grid; clips at the right edge. */
static inline void oled_text(int col, int row, const char *s)
{
    if (row < 0 || row >= OLED_ROWS || col < 0) return;
    uint8_t *p = &oled_fb[row * OLED_W + col * 6];
    while (*s && col < OLED_COLS) {
        int ch = (uint8_t) *s++;
        if (ch < 0x20 || ch > 0x7E) ch = '?';
        memcpy(p, oled_font[ch - 0x20], 5);
        p[5] = 0;                              /* 1px inter-glyph gap */
        p += 6;
        col++;
    }
}

/* Push the whole framebuffer (512B @ 8MHz ~= 0.5ms, blocking, core 0). */
static inline void oled_flush(void)
{
    if (!oled_on) return;
    static const uint8_t addr[] = { 0x21, 0, OLED_W - 1,        /* column window   */
                                    0x22, 0, OLED_PAGES - 1 };  /* page window     */
    oled_cmd(addr, sizeof addr);
    gpio_put(OLED_PIN_DC, 1);
    gpio_put(OLED_PIN_CS, 0);
    spi_write_blocking(OLED_SPI, oled_fb, sizeof oled_fb);
    gpio_put(OLED_PIN_CS, 1);
}

static inline void oled_init(void)
{
    spi_init(OLED_SPI, OLED_BAUD);
    gpio_set_function(OLED_PIN_SCK,  GPIO_FUNC_SPI);
    gpio_set_function(OLED_PIN_MOSI, GPIO_FUNC_SPI);
    gpio_init(OLED_PIN_CS);  gpio_set_dir(OLED_PIN_CS,  GPIO_OUT); gpio_put(OLED_PIN_CS, 1);
    gpio_init(OLED_PIN_DC);  gpio_set_dir(OLED_PIN_DC,  GPIO_OUT); gpio_put(OLED_PIN_DC, 0);
    gpio_init(OLED_PIN_RST); gpio_set_dir(OLED_PIN_RST, GPIO_OUT);
    gpio_put(OLED_PIN_RST, 1); sleep_ms(1);     /* boot-time only: sleeps are fine here */
    gpio_put(OLED_PIN_RST, 0); sleep_ms(10);
    gpio_put(OLED_PIN_RST, 1); sleep_ms(10);

    static const uint8_t seq[] = {
        0xAE,                   /* display off                     */
        0xD5, 0x80,             /* clock divide ratio              */
        0xA8, 0x1F,             /* multiplex 31 -> 128x32          */
        0xD3, 0x00,             /* display offset 0                */
        0x40,                   /* start line 0                    */
        0x8D, 0x14,             /* charge pump on (no ext Vcc)     */
        0x20, 0x00,             /* horizontal addressing mode      */
        0xA1,                   /* segment remap                   */
        0xC8,                   /* COM scan direction (flip)       */
        0xDA, 0x02,             /* COM pins: sequential (128x32)   */
        0x81, 0x8F,             /* contrast                        */
        0xD9, 0xF1,             /* precharge                       */
        0xDB, 0x40,             /* VCOMH deselect                  */
        0xA4,                   /* display follows RAM             */
        0xA6,                   /* normal (not inverted)           */
        0xAF,                   /* display ON                      */
    };
    oled_on = 1;
    oled_cmd(seq, sizeof seq);
    oled_clear();
    oled_text(3, 1, "extio booting..");
    oled_flush();
    printf("oled: SSD1306 128x32 SPI0 (SCK%d MOSI%d CS%d DC%d RST%d)\n",
           OLED_PIN_SCK, OLED_PIN_MOSI, OLED_PIN_CS, OLED_PIN_DC, OLED_PIN_RST);
}

#endif /* PICO_OLED_H */
