## CMakeLists.txt
```
# cpu1 -- the MCXN947 second-core image (heartbeat bring-up).
#
# Built ONLY as a sysbuild sibling of the main app (see ../sysbuild.cmake);
# never flashed on its own. CONFIG_XIP=n links the whole image into SRAMG,
# cpu0 carries the resulting zephyr.bin as an embedded blob and copies it
# there at boot (src/platform/box_cpu1.c) -- flash slot1 stays the OTA
# staging area, untouched.
cmake_minimum_required(VERSION 3.20.0)
find_package(Zephyr REQUIRED HINTS $ENV{ZEPHYR_BASE})
project(extio_cpu1)

target_sources(app PRIVATE src/main.c)
target_include_directories(app PRIVATE ../src/core)
```

## prj.conf
```kconfig
# cpu1 heartbeat image: as close to nothing as a Zephyr app gets.
#
# XIP=n is the load-bearing line: the image links into zephyr,sram (SRAMG,
# 0x20050000) with its vector table at the base -- which is exactly the
# address cpu0 writes into SYSCON->CPBOOT before releasing the core. Flash
# never enters cpu1's world at all.
CONFIG_XIP=n

# No console, no shell, no UART: cpu1's only output channel is the heartbeat
# block in SRAMH (box_ipc.h). The board dts routes cpu1's console to lpuart2
# on header pins nothing is connected to, so a console would be silence with
# a driver attached to it.
CONFIG_SERIAL=n
CONFIG_CONSOLE=n
CONFIG_UART_CONSOLE=n

# The board dts enables GPIO/LED nodes for cpu1; the heartbeat needs none of
# them, and every driver dropped is SRAM the future processing image gets.
CONFIG_GPIO=n
CONFIG_PINCTRL=n

# THE CLOCK TREE IS cpu0's PROPERTY. board_early_init_hook() begins with
# CLOCK_AttachClk(kFRO12M_to_MAIN_CLK) -- a whole-chip switch to 12 MHz --
# then re-runs the full PLL/peripheral clock setup. The upstream dual-core
# flow survives that only because it releases cpu1 at PRE_KERNEL_2, before
# cpu0 has configured anything. We release LATE, into a running system, and
# letting cpu1 re-run board init killed Ethernet + the 1588 clock on a live
# box (TSU frozen at 0, dserv registration gone, console still up -- found
# on box02, 2026-08-01). cpu1 inherits a fully configured clock tree; it
# must only ever RIDE it.
CONFIG_BOARD_EARLY_INIT_HOOK=n

CONFIG_MAIN_STACK_SIZE=1024
CONFIG_IDLE_STACK_SIZE=320
CONFIG_ISR_STACK_SIZE=1024
CONFIG_SYSTEM_WORKQUEUE_STACK_SIZE=1024
```

## src/main.c
```c
/*
 * cpu1 main -- prove the second core boots, then keep proving it is alive.
 *
 * The whole program is the write ordering: every field first, DMB, magic
 * LAST, so cpu0 (polling from the other side of the AHB matrix) never reads
 * a half-initialized block as a live heartbeat. After that it is counter++
 * at a 10 ms cadence forever -- 100 Hz is fast enough that cpu0's 1 Hz
 * monitor sees ~100 ticks between looks (a frozen counter is unambiguous
 * within one look), slow enough to be invisible in the power budget.
 *
 * k_uptime rides along so a future debugging session can tell "cpu1 wedged"
 * from "cpu1 rebooted" (a reboot restarts uptime; a wedge freezes both).
 */
#include <zephyr/kernel.h>
#include <zephyr/sys/barrier.h>

#include "box_ipc.h"

int main(void)
{
	volatile box_ipc_hb_t *hb = BOX_IPC_HB;

	hb->magic     = 0;               /* scrub first: never a stale-valid block */
	barrier_dmem_fence_full();

	hb->version   = BOX_IPC_HB_VERSION;
	hb->counter   = 0;
	hb->uptime_ms = 0;
	for (unsigned i = 0; i < ARRAY_SIZE(hb->reserved); i++) {
		hb->reserved[i] = 0;
	}
	barrier_dmem_fence_full();
	hb->magic = BOX_IPC_HB_MAGIC;    /* the block is now, and only now, live */

	for (;;) {
		hb->counter++;
		hb->uptime_ms = k_uptime_get_32();
		k_msleep(10);
	}
	return 0;
}
```
