## CMakeLists.txt
```
# extio-zephyr -- Zephyr application (freestanding; builds against $ZEPHYR_BASE).
#
#   west build -b native_sim  <this-dir>     # host smoke test, no board
#   west build -b frdm_rw612  <this-dir>     # the target
#
cmake_minimum_required(VERSION 3.20.0)

find_package(Zephyr REQUIRED HINTS $ENV{ZEPHYR_BASE})
project(extio_zephyr LANGUAGES C)

# Common to every board: core + GPIO + USB transport + the uplink arbiter.
target_sources(app PRIVATE
	src/main.c
	src/box_announce.c             # the box describing itself to dserv
	src/box_boot.c                 # why we booted + which image (OTA step 5)
	src/box_obs.c                  # obs-period state + idle-deferred work
	src/platform/box_gpio.c        # block #3: GPIO + k_timer box-timed pulse
	src/platform/box_sched.c       # scheduled events (fire at beginobs + N us)
	src/platform/box_console.c     # two-way CLI over the USB console CDC
	src/platform/box_usbd.c        # block #4: USB device (device_next) context
	src/platform/box_net_usb.c     # block #4: CDC-ACM frame transport
	src/platform/box_event.c       # service-loop wakeup (ISR-driven)
	src/platform/box_status_led.c  # the handheld's local UI (board-gated)
	src/platform/box_battery.c     # cell voltage, where a board declares vbatt
	src/platform/box_uplink.c      # block #6: uplink arbiter
	src/platform/box_pub.c         # publish queues + the uplink-writer thread
)

# Persistent settings -- exactly one box_flash backend behind box_flash.h:
#   NVS on internal flash        (RW612; flash writes are safe)
#   FAT file on the SD card      (Teensy 4.1; XIP-safe -- separate device)
# BOX_HAVE_PERSIST tells main.c that box_flash_* is available.
if(CONFIG_NVS)
	target_sources(app PRIVATE src/platform/box_flash.c)
	target_compile_definitions(app PRIVATE BOX_HAVE_PERSIST=1)
elseif(CONFIG_FILE_SYSTEM)
	target_sources(app PRIVATE src/platform/box_flash_sd.c)
	target_compile_definitions(app PRIVATE BOX_HAVE_PERSIST=1)
endif()

# BOX_HAVE_OBS_LEADER: this app's main.c carries the +30 obs-leader onset
# machinery (the at_abs obs-pin fire hook that ISR-stamps the actual instant
# and publishes actual-stamped state/in_obs). Board-independent within
# extio-zephyr, so it is an app capability, not a board one. It gates the CLI
# `obs mode leader` verb (box_cli.h) so a build WITHOUT the machinery -- an
# RP2350 image built from the same shared core -- refuses to announce an
# authority it cannot exercise. The datapoint obs/mode path is ungated (a
# leaderless box that persists mode=leader simply never fires, same as before).
target_compile_definitions(app PRIVATE BOX_HAVE_OBS_LEADER=1)

# MCUboot chainload repair: the RW6xx SoC init powers the TDDR PLL down in any
# image without Ethernet (i.e. MCUboot), and nothing ever powers it back up, so
# our ENET 1588 clock arrives dead and the first PTP read spins forever with
# interrupts disabled. Only needed when something boots before us.
if(CONFIG_SOC_SERIES_RW6XX AND CONFIG_BOOTLOADER_MCUBOOT)
	target_sources(app PRIVATE src/platform/box_soc_rw612.c)
endif()

# OTA step 2: writing the inactive MCUboot slot. Needs a real slot1_partition,
# so it rides on the same MCUboot gate -- a non-MCUboot build has no A/B pair to
# write into and links the app across where slot1 would be.
if(CONFIG_BOOTLOADER_MCUBOOT AND CONFIG_FLASH_MAP)
	target_sources(app PRIVATE src/platform/box_ota_flash.c)
	target_compile_definitions(app PRIVATE BOX_HAVE_OTA_SLOT=1)
endif()

# ---- per-board console default ----
# A fresh config (or one after `factory`) binds the box CLI to whichever console
# that BOARD can actually reach with the cable that powers it.
#
# On the FRDM-MCXN947 the console UART is the MCU-Link VCOM, and J17 supplies
# BOTH power and that VCOM -- so one cable brings the board up AND shows its
# config console, which is what bringing a box up at a new site needs. The USB
# CDC console needs a second cable to a port that does not power the board, and
# in `mode eth` the data pipe is suppressed anyway, so the CDC has no other job.
#
# Deliberately NOT global: on the Teensy the same setting means lpuart6 on pins
# 0/1 and a soldered-on USB-serial adapter, where defaulting to uart would make
# a healthy box look dead. Every other board keeps CDC.
#
# The nRF52840 DK is the MCXN947's case, not the Teensy's, and 2026-08-22 is
# when that got established rather than assumed: its J-Link OB exposes a VCOM on
# uart0 (P0.06/P0.08) over the SAME USB connector (J2) that powers the board,
# while the box's CDC console lives on the separate nRF USB port (J3) and needs
# a second cable. Flashed with the CDC default, the first boot printed exactly
# one line -- Zephyr's own banner -- and nothing from the box, on a board that
# was provably running (PC in arch_cpu_idle). A healthy box looking dead is the
# failure this gate exists to prevent, so the DK joins it.
#
# The XIAO nRF54LM20A does NOT, and the distinction is the point: that module
# has no debugger VCOM at all -- its single USB connector IS the nRF USB device
# port -- so CDC is the only console it has and the default is already right.
#
# The nRF54LM20 DK joins on 2026-08-31, VERIFIED rather than assumed -- which is
# what its overlay asked for when it deferred this decision as a scout. Its
# cpuapp dtsi chooses `uart20` for zephyr,console, uart20 is an IMCU VCOM, and
# the IMCU USB port is the one connector the board's own doc tells you to plug
# in. Flashed with the CDC default it reproduced the nRF52840 DK's symptom
# exactly: VCOM1 printed Zephyr's banner and not one line from the box.
if(CONFIG_BOARD_FRDM_MCXN947 OR CONFIG_BOARD_NRF52840DK OR CONFIG_BOARD_NRF54LM20DK)
	target_compile_definitions(app PRIVATE BOX_DEFAULT_CONSOLE_MODE=CONSOLE_MODE_UART)
endif()

# ---- boards whose bootloader is an Adafruit-style UF2 loader ----
# Lets cmd/bootsel actually reach it (main.c box_reboot_to_uf2), instead of
# answering "not supported on this board".
#
# A property of the BOOTLOADER THE BOARD SHIPS WITH, which is why this is a
# board list and not a Kconfig: nothing we build decides it, and no symbol
# Zephyr defines reports it. Every board below was confirmed by reading
# INFO_UF2.TXT off its mounted volume -- and NOTE THE FAMILY IDS DIFFER: the
# XIAO and the MDK dongle stamp 0xADA52840, the Raytac MDBT50Q-RX stamps
# 0x239a010b (its own VID/PID). Family ids are per-BOARD here, not per-SoC, so
# a .uf2 built with another board's number is simply the wrong file. Read the
# file on the device.
#
# It matters most on the dongle, which is SEALED and lives in a USB port behind
# a machine: without this, every reflash needs someone to hold its button while
# plugging it in -- the one step in the update cycle a host cannot perform. The
# XIAO joins because it is the same bootloader and the same argument applies to
# a handheld in someone's pocket.
#
# DO NOT add a board here on the strength of it accepting .uf2 files. The RP2350
# also does, via a completely different mechanism (the bootrom's BOOTSEL, driven
# by reset_usb_boot()), and writing 0x57 to a Nordic retention register would do
# nothing there. This define means specifically "Adafruit's nRF52 bootloader,
# triggered by GPREGRET".
if(CONFIG_BOARD_XIAO_BLE OR CONFIG_BOARD_NRF52840_MDK_USB_DONGLE
   OR CONFIG_BOARD_RAYTAC_MDBT50Q_CX_40_DONGLE)
	target_compile_definitions(app PRIVATE BOX_HAVE_UF2_BOOTLOADER=1)
endif()

# ---- second core (MCXN947 + sysbuild only) ----
# The cpu1 heartbeat image (cpu1/, built by sysbuild.cmake) rides inside THIS
# image as a generated byte array; box_cpu1.c copies it to SRAMG and releases
# the core. Gated on SYSBUILD so the plain build-mcxn947 compile-check dir --
# which has no cpu1 sibling image to embed -- still builds, just without a
# second core. See box_cpu1.c for why the vendor CONFIG_SECOND_CORE_MCUX
# path (XIP from slot1) is exactly what we must not do on an OTA box.
if(CONFIG_BOARD_FRDM_MCXN947 AND SYSBUILD)
	target_sources(app PRIVATE src/platform/box_cpu1.c)
	target_compile_definitions(app PRIVATE BOX_HAVE_CPU1=1)
	generate_inc_file_for_target(app
		${CMAKE_BINARY_DIR}/../cpu1/zephyr/zephyr.bin
		${ZEPHYR_BINARY_DIR}/include/generated/cpu1_fw.inc)
endif()

# Analog input: compiled wherever Zephyr's ADC subsystem is enabled. The file
# itself degrades to stubs when the board declares no `box_adc` node, so a board
# with CONFIG_ADC on for some other reason still links.
if(CONFIG_ADC)
	target_sources(app PRIVATE
		src/platform/box_adc.c         # one sweep, over Zephyr's ADC API
		src/platform/box_ain.c         # the sampling thread + group packing
	)
	target_compile_definitions(app PRIVATE BOX_HAVE_ADC=1)
endif()

# Hardware-paced ADC streaming (Stage 0: the streamtest instrument).
if(CONFIG_BOX_ADC_STREAM)
	target_sources(app PRIVATE
		src/platform/box_adc_stream.c  # CTIMER -> INPUTMUX -> LPADC -> eDMA ring
	)
endif()

# Ethernet + PTP: frdm_rw612 and teensy41 (teensy40 has no PHY).
if(CONFIG_NETWORKING)
	target_sources(app PRIVATE
		src/platform/box_net_eth.c     # block #5: Ethernet transport (sockets)
		src/platform/box_ptp.c         # block #5: ENET IEEE-1588 hardware clock
		src/platform/box_beacon.c      # LAN discovery broadcast (UDP :5011)
		src/platform/box_fetch.c       # OTA pull worker ('<' binary-get)
	)
endif()


# BLE, in exactly one of its two roles.
#
# THE ROLE IS A BUILD CHOICE, not a runtime one, and the reason is power rather
# than code size: the central scans and holds up to CONFIG_BT_MAX_CONN links,
# which is precisely what the battery peripheral cannot afford. BLE.md's policy
# ("compiled per-board, enabled at runtime") applies to the RADIO -- cfg->ble_en
# -- not to which end of the pipe this box is.
#
# BOX_BLE_CENTRAL is defined rather than testing !CONFIG_BOX_BLE_PERIPHERAL at
# every site, because main.c and box_console.c each have several and a missed
# one links a hub into a handheld.
if(CONFIG_BT AND CONFIG_BOX_BLE_PERIPHERAL)
	target_sources(app PRIVATE
		src/platform/box_ble_periph.c  # the handheld end: GATT server + uplink
	)
elseif(CONFIG_BT)
	target_sources(app PRIVATE
		src/platform/box_ble.c         # block #6: multi-peripheral BLE central
	)
	target_compile_definitions(app PRIVATE BOX_BLE_CENTRAL=1)
endif()

# ---- the build version, baked in ----
#
# So a box can say WHICH IMAGE it is running. An MCUboot box reads that out of
# its own image header at runtime; a UF2 box has no header, so without this it
# reports no version at all and "is this dongle up to date?" is unanswerable --
# which is exactly where the nRF52840 dongles were.
#
# Regenerated as a BUILD step rather than at configure time, because a version
# captured when CMake last ran goes stale the moment you commit, and a box
# confidently reporting an image it is not running is worse than one reporting
# nothing. The script rewrites the header only when the string changes, so an
# unchanged tree does not relink.
set(BOX_VERSION_H ${ZEPHYR_BINARY_DIR}/include/generated/box_version.h)
add_custom_target(box_version_h ALL
  BYPRODUCTS ${BOX_VERSION_H}
  COMMAND ${CMAKE_COMMAND}
          -DSRC_DIR=${CMAKE_CURRENT_SOURCE_DIR}
          -DOUT=${BOX_VERSION_H}
          -P ${CMAKE_CURRENT_SOURCE_DIR}/cmake/gen_box_version.cmake
  COMMENT "box_version.h (git describe)"
  VERBATIM)
add_dependencies(app box_version_h)

# The portable core (forked from wiznet-io, pico_* -> box_*) plus the RW612/Zephyr
# platform layer, added building-block by building-block.
target_include_directories(app PRIVATE src src/core src/platform)

# ---- network stack -> ITCM ----------------------------------------------------
# The box XIPs from external QSPI flash (CONFIG_XIP=y on Teensy 4.x), so every
# instruction-cache miss is a FlexSPI fetch. Our service loop is small and runs
# constantly, so it stays hot -- measured at 10 us per idle pass. The network
# stack is large and runs intermittently, so it is cold on every publish, and a
# single 128-byte zsock_send() measured 275-864 us of CPU (state/dbg/send_us,
# 2026-07-24). The VARIABILITY is the tell: DMA waits and protocol timers do not
# swing 3x, cache state does. Ruled out beforehand: Nagle, syscall count, TX
# traffic classes, and TX descriptor depth -- see boards/teensy41.conf.
#
# CONFIG_CODE_DATA_RELOCATION is already on, and the in-tree precedent is the
# FlexSPI flash driver, which relocates itself to ITCM for the same reason
# (drivers/flash/CMakeLists.txt). ITCM is 128 KB with ~9 KB used, so there is
# room; if there is not, the link fails loudly rather than silently degrading.
if(CONFIG_NETWORKING AND CONFIG_CODE_DATA_RELOCATION)
	zephyr_code_relocate(LIBRARY subsys__net__ip           LOCATION ITCM_TEXT)
	zephyr_code_relocate(LIBRARY subsys__net__l2__ethernet LOCATION ITCM_TEXT)
	zephyr_code_relocate(LIBRARY drivers__ethernet         LOCATION ITCM_TEXT)
	zephyr_code_relocate(LIBRARY lib__net_buf              LOCATION ITCM_TEXT)
endif()
```

## Kconfig
```
# extio-zephyr app-level Kconfig overrides.
# Sourced by the Zephyr build before the upstream defaults, so a `default` here
# wins for promptless symbols.

# DO NOT override USBD_CDC_ACM_TX_DELAY_MS (upstream default 100 ms).
#
# It looks like a Linux-tty quirk, so this app briefly set it to 0. That caused
# every console symptom we chased for a day: shredded output, mangled ANSI
# escapes, and terminals dropping mid-command on BOTH macOS and Linux.
#
# The delay is protection, not a workaround. A host tty starts with ECHO ON and
# the opening application disables it a moment later; the delay keeps the device
# quiet through that window. Transmit into it and the host reflects the banner
# and prompt straight back into our RX -- the shell then reads its own output as
# input, answers it, and that answer gets echoed back again. A feedback storm.
#
# The frame-pipe CDC survived it because its framer resyncs on '>' and silently
# discards junk. The console is the only endpoint that REPLIES, so it is the only
# one that amplifies. If an interactive console ever misbehaves again, check this
# symbol before suspecting the terminal or the host OS.

config BOX_BLE_PERIPHERAL
	bool "Build this box as a BLE PERIPHERAL (the radio is its uplink)"
	default n
	depends on BT_PERIPHERAL
	help
	  A battery handheld whose events reach dserv through a receiver, not
	  through USB or Ethernet: box_ble_periph.c presents the frozen d5e7000x
	  GATT pipe as an ordinary uplink, so everything above the transport --
	  config dispatch, the announce/manifest, DI, groups, ain groups, the
	  CLI, persistence -- is unchanged.

	  MUTUALLY EXCLUSIVE WITH THE CENTRAL by construction, and the reason is
	  power rather than code: box_ble.c scans and holds up to
	  CONFIG_BT_MAX_CONN links, which is exactly what a coin cell cannot
	  afford. BLE.md's policy is "compiled per-board, enabled at runtime",
	  so the ROLE is a build choice and only the radio itself is a runtime
	  one (cfg->ble_en).

	  TWO CONSEQUENCES worth knowing before turning this on:

	  * USB becomes CONSOLE-ONLY. The data pipe is not enumerated -- a
	    peripheral's frames go out the radio, and a host that saw a pipe the
	    box never writes would list it in extio/boxes as USB-attached and
	    poll it forever (the Pico handheld's "dead data CDC", BLE.md).

	  * EVENT TIMESTAMPS BECOME RAW SOURCE TIME. A peripheral is never
	    anchored -- nothing sends it ess/in_obs -- so box_clock_stamp()
	    would return 0 for every event and dserv would arrival-stamp away
	    the very source stamp this tier exists to preserve. The receiver
	    rewrites the ts at the radio boundary instead ("translate exactly
	    once"), which is measured to land within ~1 ms.

config BOX_ADC_STREAM
	bool "Hardware-paced ADC stream pipeline (CTIMER -> LPADC -> eDMA ring)"
	default n
	depends on DMA && NXP_INPUTMUX && ADC_MCUX_LPADC
	help
	  Timer-triggered LPADC acquisition with eDMA moving results into a
	  cyclic SRAM ring: the CPU leaves the sample path, and sample times
	  become trigger-clock arithmetic instead of thread wakeups. Stage 0
	  ships only the cmd/ain/streamtest bring-up instrument; the polled
	  sampler is untouched. MCXN947-class parts (needs the CTIMER->ADC
	  INPUTMUX route and the FIFO DMA request line).

config BOX_ADC_STREAM_DEFAULT
	bool "Use the hardware-paced pipeline as the default sampler pacing"
	default n
	depends on BOX_ADC_STREAM
	help
	  What `ain pace auto` resolves to. Off = the polled sampler, with the
	  stream reachable per box (`ain pace stream`); on = every box on this
	  firmware samples hardware-paced unless it is explicitly pinned to
	  `ain pace polled`.

	  A FIRMWARE SWITCH RATHER THAN A CONFIG DEFAULT, deliberately: config
	  blobs are append-only and load older fields as zero, so a boolean
	  "use stream" in box_config_t would have meant that the day this
	  becomes the default, every box carrying a saved blob still loads
	  polled -- a default only factory-fresh boxes ever see. Here, flipping
	  the fleet is an OTA, and reverting it is the previous image.

	  Turn this on once the stream has been soaked on a real rig; until
	  then the bench box opts in by hand.

source "Kconfig.zephyr"
```

## sysbuild.conf
```
# Sysbuild config -- builds MCUboot alongside the app.
#
#   west build -b frdm_mcxn947/mcxn947/cpu0 --sysbuild <this-dir> -d build-mcxn-ota
#   west build -b teensy40                  --sysbuild <this-dir> -d build-teensy40-ota
#
# This file is INERT unless --sysbuild is passed, so a plain `west build -b
# teensy40 .` is unaffected and keeps linking at flash base.
#
# THE REFERENCE CONFIGURATION IS THE MCXN947 (build-mcxn-ota). It is the one that
# has actually been exercised in the field; the RW612 path builds and booted but
# has had far less use, so copy geometry and swap mode from the MCXN947 when
# bringing up a new board, not from the RW612.
#
# Swap mode is left at sysbuild's default, which resolves here to
# SB_CONFIG_MCUBOOT_MODE_SWAP_USING_OFFSET with EQUAL-sized slots -- what
# build-mcxn-ota ships (boot 80 KB, slot0 = slot1 = 984 KB). Stated because it is
# load-bearing and invisible: swap modes disagree about whether the secondary
# slot may differ in size, so a board whose slots are not equal has changed the
# algorithm's assumptions without saying so.
#
# Why MCUboot at all: it is step 1 of the OTA port (wiznet-io/OTA.md). On the
# RP2350 the bootrom provided the A/B slots, the try-before-you-buy flag and the
# revert-on-reset; here MCUboot provides all three, plus image signing, which
# was the one open question in the RP2350 design.
#
# On the FRDM boards the flash layout it needs is ALREADY in the board's
# devicetree and was already correct -- we simply were not using it (RW612):
#
#   boot_partition   (mcuboot)  @0x000000   128 KB
#   slot0_partition  (image-0)  @0x020000     3 MB   <- app runs here
#   slot1_partition  (image-1)  @0x320000     3 MB   <- OTA writes here
#   storage_partition           @0x620000   ~58 MB   <- NVS, OUTSIDE both slots
#
# The TEENSY40 defines none of that -- the PJRC board DTS has no partitions and no
# zephyr,code-partition -- so boards/teensy40.overlay carves the whole layout and
# names the code partition itself. See the long note there, in particular why
# nothing may extend past 0x1FF000: the last sector of that 2 MB part accepts an
# erase and silently ignores it, and MCUboot puts an image trailer at the END of a
# slot, so a slot running to the top of flash would fail mid-swap.
#
# storage_partition sitting outside both slots is what makes "config survives an
# update" a property of the layout rather than something we have to engineer.
#
# Turning this on MOVES THE APP: without it CONFIG_FLASH_LOAD_OFFSET=0 and the
# app links at the flash base, spanning boot_partition into slot0.
# CONFIG_BOOTLOADER_MCUBOOT selects USE_DT_CODE_PARTITION, so the app relinks to
# slot0 and grows an MCUboot image header. That is a one-time layout migration
# and needs one flash of BOTH images -- SWD on the FRDM boards, one HalfKay
# button press on a Teensy, exactly parallel to the Pico needing one BOOTSEL
# flash before OTA can take over.
SB_CONFIG_BOOTLOADER_MCUBOOT=y
```

## prj.conf
```kconfig
# extio-zephyr -- COMMON config for every supported board.
# Board-specific subsystems live in boards/<board>.conf (auto-merged by Zephyr):
#   frdm_rw612 -> Ethernet+PTP + BLE      (the universal hub)
#   teensy41   -> Ethernet+PTP, no radio  (wired test system)
#   teensy40   -> USB only                (USB-HS test system)

CONFIG_PRINTK=y
CONFIG_CBPRINTF_FP_SUPPORT=n

# block #3: box_gpio -- DO/DI via the box-gpio-port alias (set per board).
# Box-timed pulses + scheduled events ride k_timer (100 us tick, see
# CONFIG_SYS_CLOCK_TICKS_PER_SEC) -- NOT the counter API; the mcux GPT counter
# driver fires stale alarms instantly (PORTING.md).
CONFIG_REBOOT=y          # cmd/reboot -> warm reset (portable)
CONFIG_GPIO=y

# block #4: USB-HS CDC transport. device_next stack (High-Speed on both the
# RW612 and the RT1062), CDC-ACM frame pipe + console, irq-driven UART + DTR.
CONFIG_USB_DEVICE_STACK_NEXT=y
CONFIG_USBD_CDC_ACM_CLASS=y
CONFIG_UART_INTERRUPT_DRIVEN=y
CONFIG_UART_LINE_CTRL=y
CONFIG_RING_BUFFER=y
CONFIG_HWINFO=y            # USB serial number derived from the device HWID
# UDC request-buffer pool. The upstream defaults (16 buffers / 1024 BYTES
# total) leave a High-Speed device ~two 512 B bulk buffers for EVERY endpoint
# of both CDC interfaces combined. Measured consequences on the MCXN947
# (extio_test campaign, 2026-08-02): any host->box burst past ~8 of our 128 B
# frames died at the controller ("Failed to allocate slab" / "UDC error
# event"), and TX contended for the same starved pool (usb_send_max_us hit
# 45 ms), which is the stall window behind swallowed DI pulses and analog
# sweep underruns. 64 buffers / 16 KB gives the pipe real headroom for ~15 KB
# more RAM (board sits at ~58% RAM with plenty free).
CONFIG_UDC_BUF_COUNT=64
CONFIG_UDC_BUF_POOL_SIZE=16384
# ...and the one that actually gated the burst cliff: the NXP UDC driver's
# INTERNAL EVENT SLAB (udc_mcux_ehci.c udc_event_slab). Every USB completion
# posts one event from the ISR; the work queue drains them. At the 4-block
# default, any packet burst deeper than the slab loses completions outright
# ("Failed to allocate slab") -- measured as exactly ~8 of 20 back-to-back
# 128 B frames surviving, unchanged by the buf-pool bump above. 16 is the
# Kconfig range maximum; if bursts ever outrun it, patch the range
# (patches/ convention) rather than re-tuning around it.
#
# THE ASSIGNMENT LIVES IN THE FOUR NXP BOARD CONFS, not here -- the reasoning
# stays in this file because it is one story and it belongs next to the buf-pool
# note above. UDC_NXP_EVENT_COUNT is defined in drivers/usb/udc/Kconfig.mcux and
# only exists on a board whose USB controller is an NXP one. Setting it here
# warned harmlessly on the nRF52840 DK and was a HARD BUILD FAILURE on the XIAO
# nRF54LM20A ("error: Aborting due to Kconfig warnings") -- a common file
# carrying a vendor-specific symbol, found by the 2026-08-22 scout ports.
# NOTE: the CDC-ACM "echo mitigation" first-TX delay (USBD_CDC_ACM_TX_DELAY_MS)
# is left at its upstream 100 ms default ON PURPOSE -- see the app Kconfig for
# why zeroing it produced a host-echo feedback storm on the console CDC.
#
# ...and THE POOL ABOVE WAS NOT REACHING THE CDC DATA PATH AT ALL.
#
# USBD_CDC_ACM_BUF_POOL defaults to `y if !USBD_MAX_SPEED_FULL`, so on every
# High-Speed board -- teensy40/41, mcxn947, rw612, rt1186, the nRF54LM20s --
# usbd_cdc_acm.c allocated its bulk buffers from its OWN pool instead:
#
#     UDC_BUF_POOL_DEFINE(cdc_acm_ep_pool,
#                         DT_NUM_INST_STATUS_OKAY(DT_DRV_COMPAT) * 2, ...)
#
# Two CDC instances => FOUR 512 B buffers, shared between the console and the
# frame pipe, while the 64 buffers / 16 KB tuned above sat unused by the very
# traffic they were sized for (they still serve control transfers and the
# notification endpoint). Each instance permanently parks one on a pending
# bulk-OUT, so the two pipes were splitting two buffers for all TX.
#
# When the alloc fails, cdc_acm_tx_fifo_handler() clears TX_FIFO_BUSY and arms
# a K_MSEC(1) retry -- via k_work_SCHEDULE, which is a NO-OP while the item is
# already scheduled, so every K_NO_WAIT kick from box_net_usb's
# uart_irq_tx_enable() is swallowed until that timer fires. A starved pool
# therefore degrades the data pipe to 1 ms-granularity stuttering with no
# counter anywhere recording it. Symptom on `astick` (teensy40, 2026-09-15):
# analog held ~100 ms once a second, then delivered in one burst -- and setting
# `console uart`, which stops box_console claiming the second CDC, made it go
# away. Falling back to the UDC pool gives both instances real headroom.
#
# Safe in this common file (unlike UDC_NXP_EVENT_COUNT above): the symbol is
# defined wherever USBD_CDC_ACM_CLASS is, i.e. on every target we build, and it
# is already `n` on the Full-Speed nRF boards -- so this changes only the HS
# ones, which are exactly the affected set.
CONFIG_USBD_CDC_ACM_BUF_POOL=n
# CONFIG_USBD_CDC_ACM_WORKQUEUE was tried for data-vs-console contention and did
# not fix it -- but that is NOT evidence against the console, and the old note
# here implied it was. The symbol creates ONE cdc_acm_work_q shared by BOTH
# class instances, started at CONFIG_SYSTEM_WORKQUEUE_PRIORITY
# (usbd_cdc_acm.c:171-186). It does not give the frame pipe its own thread; it
# only separates cdc_acm from OTHER system-workqueue users. It cannot address
# console-vs-data contention by construction, so leave it off and look at the
# shared resources (the buffer pool above) instead.

# Management console = a small interrupt-driven CLI over the console CDC
# (src/platform/box_console.c): own RX/TX ring buffers, drained in the service
# loop, so it is single-threaded with the rest of the box -- no cfg locking, no
# extra thread.
#
# We briefly used Zephyr's Shell subsystem here. It is nicer (tab-completion,
# history) but it cost ~0.25 ms of MEDIAN round-trip latency -- measured, and
# independent of both the backend transport and the shell thread priority (see
# PORTING.md "RTT re-measured"). This is a timing box and the console is a
# one-off convenience, so the trade is not worth it.
#
# NOTE the original reason for abandoning this console was WRONG: the byte
# shredding was dserv's extio subprocess opening the console port (bad USB
# product string + inverted CDC order), not this code. Both are fixed.

# headroom for the net stack where it is enabled; harmless otherwise
CONFIG_MAIN_STACK_SIZE=4096

# ---- the priority lattice serves DATA PRESERVATION first ----
# Directive (2026-08-02): for this box, knowing exactly what happened
# outranks having it happen fast. A sweep that never ran is a hole nothing
# can backfill; a block delivered late carries honest timestamps and is a
# complete record. So data CREATION outranks data SHIPPING:
#
#   coop -2  analog sweep (box_ain; +26 moved it cooperative -- a due
#            sweep must not lose a timeslice race)
#   1        ADC driver threads (per-board; run the moment a sweep blocks
#            in adc_read)
#   2        network RX (ENET_QOS boards, set in the board conf; +28 --
#            arrival is creation-adjacent: it carries the commands and the
#            PTP timestamps. The driver default 3 became MAIN's EQUAL when
#            main moved to 3, and equal preemptive priorities do not
#            preempt: a long service pass blocked descriptor recycling and
#            produced measured RX underruns. See the board conf.)
#   2        eth uplink reader (box_net_eth.c; +29 -- receives, stamps and
#            fast-paths the schedule classes AT arrival, so at/at_abs
#            arming no longer waits on a service pass. Same seat as the
#            driver RX thread it drains.)
#   3        service loop (MAIN: obs/DI publish, uplink, console)   <- was 0
#   4        publisher (box_pub)                                    <- was 3
#
# DI capture and timestamps are ISR-level and lose nothing; only delivery
# can slip by the microseconds a sweep takes. The old order (service above
# sweep) was the responsiveness-first default and produced measured sweep
# underruns (st_late) under concurrent USB TX.
CONFIG_MAIN_THREAD_PRIORITY=3

# ---- make thread death LOUD and stack sizing MEASURED ----
# Context: the eth RX-wake thread died silently twice (dbg/wake_us frozen,
# box otherwise healthy), and the first postmortem guessed "stack overflow"
# and doubled the stack. That guess was untestable precisely because nothing
# here made death visible. Two facts, established 2026-08-01 and worth not
# re-deriving: (1) every supported board ALREADY runs hardware stack
# protection (PSPLIM on the Cortex-M33s via BUILTIN_STACK_GUARD, MPU guards
# on the RT10xx Teensys) -- an overflow is a loud fatal, and the default
# fatal handler HALTS the box, so "one thread quietly gone while the rest
# runs" is proof it was NEVER an overflow; (2) with THREAD_NAME off, the
# k_thread_name_set() calls this codebase already makes were no-ops and any
# fault dump says "unknown" -- worth a few bytes per thread to fix.
# INIT_STACKS watermarks stacks (0xAA fill at create) so
# k_thread_stack_space_get() reports REAL headroom -- published 1 Hz as
# dbg/ethrx_stack_free, so the next "raise the stack" starts from a
# measurement. Cost: a one-time memset per thread creation, nothing per-pass.
# (The RW612 build already carried both -- pulled in by its shell config, not
# stated anywhere -- so only the Teensys and the MCXN947 actually change.)
CONFIG_INIT_STACKS=y
CONFIG_THREAD_NAME=y

# Persistent settings (box_flash, NVS) are enabled PER BOARD, not here: on the
# Teensy the app XIP-executes from its only flash, and enabling the FlexSPI NOR
# driver re-inits that controller and hard-faults at boot. So NVS lives in
# boards/frdm_rw612.conf (separate storage, no XIP conflict). A Teensy build
# runs without persistence until a working XIP-safe recipe is found.

# CONFIG_ADC=y             # block #7: GAU GPADC vs external MCP3204
# CONFIG_SETTINGS=y        # persistence backend for box_persist
```

## central.conf
```kconfig
# The BLE CENTRAL variant of a board (build with -DEXTRA_CONF_FILE=central.conf).
#
# The mirror of periph.conf, and kept out of any board .conf for the same
# reason: the plain box is what you bring a new board up as, and it is what you
# fall back to when the radio is the suspect. A board file that hard-wires the
# radio role cannot do either.
#
# WHY THIS EXISTS SEPARATELY FROM boards/frdm_rw612.conf, which carries the same
# settings inline: the RW612 is only ever a central -- it is the Ethernet/PTP
# hub, and a board with a wired uplink has no business being a battery
# peripheral. An nRF52840 is the opposite: the SAME silicon is the peripheral
# (XIAO, boards/xiao_ble.*) and, on a dongle, a plausible USB-only central. So
# on that family the role has to be a build choice, exactly as the peripheral's
# already is, or one board file would have to pick for both.
#
#   west build -b <dongle> . -- -DEXTRA_CONF_FILE=central.conf
#
# VERIFIED TO FIT on nrf52840dk/nrf52840 (same SoC as every candidate dongle),
# 2026-09-01: 239,228 B flash of 1 MB (23%), 172,788 B RAM of 256 KB (66%). The
# RAM number is the one to watch when raising BT_MAX_CONN -- the connection
# pool and its buffers are what grow.
CONFIG_BT=y
CONFIG_BT_CENTRAL=y
CONFIG_BT_OBSERVER=y
CONFIG_BT_GATT_CLIENT=y

# Fleet ceiling. box_ble.c walks 0..CONFIG_BT_MAX_CONN-1 and stops scanning
# while full, so this is the real "how many handhelds in one room" number.
CONFIG_BT_MAX_CONN=8
CONFIG_BT_MAX_PAIRED=8
CONFIG_BT_SMP=y

# The frozen contract (src/core/dserv_ble.h): one whole 128-byte dserv_msg per
# ATT PDU, no fragmentation layer. 131 = DSERV_BLE_MTU_MIN (128 + the 3-byte
# ATT header). Both ends verify this after the automatic exchange and refuse
# the pipe below it rather than silently halving the frame.
CONFIG_BT_L2CAP_TX_MTU=131
CONFIG_BT_BUF_ACL_RX_SIZE=135
CONFIG_BT_BUF_ACL_TX_SIZE=135
CONFIG_BT_DATA_LEN_UPDATE=y

# NOTE FOR AN nRF52840 CENTRAL, and it is a real difference from the RW612
# rather than a footnote: this SoC's NRF_RTC_TIMER does not select
# TIMER_HAS_64BIT_CYCLE_COUNTER, so box_gpio_now_us() takes the
# k_uptime_ticks() fallback at 30.5 us granularity. On the PERIPHERAL that was
# measured at ~5% of the tier's 0.55 ms IQR and is not the limit
# (BLE_PERIPHERAL.md). On a central it lands in the same place in the budget,
# but it is now on BOTH ends of the estimator rather than one.
#
# The larger difference is that a USB dongle has NO PTP. box3 disciplines its
# clock to dserv over Ethernet 1588; a dongle anchors on the obs edge
# (BOX_SYNC_DP, ess/in_obs) like every other USB box, and EVERY peripheral's
# timestamp is mapped through the central's clock. That is consistent with
# BLE.md's tiering -- Ethernet rigs are time-critical, USB behavioural rigs are
# the BLE home -- but it does mean a dongle fleet should not be expected to
# reproduce box3's numbers.
```

## periph.conf
```kconfig
# The BLE PERIPHERAL variant of a board (build with -DEXTRA_CONF_FILE=periph.conf).
#
# Kept OUT of any board .conf so both images stay buildable from one board file:
# the plain box is what you bring a new board up as, and it is the thing you fall
# back to when the radio is the suspect.
CONFIG_BT=y
CONFIG_BT_PERIPHERAL=y
CONFIG_BT_DEVICE_NAME="extio"
CONFIG_BT_MAX_CONN=1
CONFIG_BT_GATT_DYNAMIC_DB=n

# One whole 128-byte dserv_msg per ATT PDU -- the frozen contract. 131 is
# DSERV_BLE_MTU_MIN (128 + the 3-byte ATT header); both ends verify after the
# automatic exchange and refuse the pipe below it rather than fragmenting.
CONFIG_BT_L2CAP_TX_MTU=131
CONFIG_BT_BUF_ACL_RX_SIZE=135
CONFIG_BT_BUF_ACL_TX_SIZE=135
CONFIG_BT_ATT_PREPARE_COUNT=0
CONFIG_BT_GATT_CLIENT=n

# The role itself (src/platform/box_ble_periph.c, and the raw-source-time stamp).
CONFIG_BOX_BLE_PERIPHERAL=y

# ---- THE CENTRAL OWNS CONNECTION TIMING. Do not let this end renegotiate. ----
#
# Zephyr peripherals default to BT_GAP_AUTO_UPDATE_CONN_PARAMS=y with a
# preference of 24-40 units (30-50 ms), and request it shortly after connect.
# That silently overrides whatever the central chose: MEASURED on the first
# connection of this port, `conn_int=45.00 ms` on a central that had pinned 7.5.
#
# It is not a cosmetic difference. The echo midpoint bias is (leg2-leg1)/2 with
# leg2 interval-quantised, so it scales with the interval -- +1.12 ms at 7.5 ms
# and +5.39 ms at 15 ms, both measured against a hardware ground truth. At 45 ms
# the tier would miss its ~1 ms target by roughly an order of magnitude, and
# nothing on either console would have said so before the negotiated interval
# was reported (it is what caught this).
#
# BLE.md already assigns this: "the central dictates connection parameters, so
# the RECEIVER owns this" -- it is the end running the estimator and the
# latency manager. So the peripheral accepts what it is given.
CONFIG_BT_GAP_AUTO_UPDATE_CONN_PARAMS=n

# Kept consistent anyway, because these are also published in the GAP PPCP
# characteristic: a DIFFERENT central reading our preference should be told
# 7.5 ms, not Zephyr's generic default. Timeout 400 (4 s) matches the central's
# and leaves room for peripheral latency; the stock 42 (420 ms) does not.
CONFIG_BT_PERIPHERAL_PREF_MIN_INT=6
CONFIG_BT_PERIPHERAL_PREF_MAX_INT=6
CONFIG_BT_PERIPHERAL_PREF_LATENCY=0
CONFIG_BT_PERIPHERAL_PREF_TIMEOUT=400
```

## boards/frdm_rw612.conf
```kconfig
# FRDM-RW612 -- the universal hub: Ethernet+PTP AND the BLE fleet radio.

# block #5: Ethernet + hardware PTP. The board wires ENET + a KSZ8081 PHY (RMII)
# and the MAC carries the 1588 clock, so this is stack + transport only.
CONFIG_NETWORKING=y
CONFIG_NET_L2_ETHERNET=y
CONFIG_ETH_NXP_ENET=y
CONFIG_NET_IPV4=y
CONFIG_NET_DHCPV4=y
# Send the first DHCPDISCOVER after a FIXED 1 s instead of a random 1-9 s.
#
# RFC 2131 4.4.1 asks clients to randomise that first delay so a room full of
# machines coming back after a power cut does not hit the server in one burst.
# Zephyr implements it as `entropy % (MAX - 1) + 1` (subsys/net/lib/dhcpv4),
# and the default MAX of 10 put a random 1-9 s hole in the middle of every boot
# -- measured on box3 as boot-to-registration wandering 13.7/14.7/15.7 s across
# three otherwise identical reboots. Kconfig's range floor is 2, which makes the
# expression collapse to exactly 1 s: still delayed, no longer a lottery.
#
# The flood this protects against is a real thing at campus scale; a rig with a
# handful of boxes on its own switch is not that, and a deterministic boot is
# worth more here than staggering three DISCOVERs.
CONFIG_NET_DHCPV4_INITIAL_DELAY_MAX=2
CONFIG_NET_TCP=y
# TCP keepalive -- for the connect-back slot (box_net_eth.c srv_conn) only.
# WITHOUT THIS the SO_KEEPALIVE setsockopt is not merely ineffective: Zephyr
# gates the entire option on this Kconfig and otherwise falls through to
# ENOPROTOOPT, which is precisely how the beacon's SO_BROADCAST silently did
# nothing for a whole release. Checked in sockets_inet.c before relying on it.
CONFIG_NET_TCP_KEEPALIVE=y
CONFIG_NET_SOCKETS=y
CONFIG_NET_MGMT=y
CONFIG_NET_MGMT_EVENT=y
CONFIG_PTP_CLOCK=y
CONFIG_PTP_CLOCK_NXP_ENET=y   # instantiate the ENET 1588 clock device
CONFIG_NET_PKT_TIMESTAMP=y

# block #6: multi-peripheral BLE central (frozen d5e7000x pipe). RW612 tri-radio.
# NOTE: needs `west blobs fetch hal_nxp` (accept NXP's controller firmware
# license) or the build fails on the missing signed cpu2/NBU image.
CONFIG_BT=y
CONFIG_BT_CENTRAL=y
CONFIG_BT_OBSERVER=y
CONFIG_BT_GATT_CLIENT=y
CONFIG_BT_MAX_CONN=8
CONFIG_BT_MAX_PAIRED=8
CONFIG_BT_SMP=y
CONFIG_BT_L2CAP_TX_MTU=131
CONFIG_BT_BUF_ACL_RX_SIZE=135
CONFIG_BT_BUF_ACL_TX_SIZE=135
CONFIG_BT_DATA_LEN_UPDATE=y

# persistent settings: NVS on the RW612's storage_partition (box_flash). The
# RW612 does not XIP from a flash we write here the way the Teensy does, so the
# FlexSPI/flash driver is safe. (Untested until an FRDM-RW612 is on the bench.)
CONFIG_FLASH=y
CONFIG_FLASH_MAP=y
CONFIG_NVS=y
CONFIG_MPU_ALLOW_FLASH_WRITE=y

# main() on this board initialises BT + net + USB; the shared prj.conf value
# (4096) overflows on entry. Sized empirically 2026-07-25.
CONFIG_MAIN_STACK_SIZE=16384

# `cmd/save` failed on this board with nvs_mount -> -45. That is EDEADLK, NOT
# ENOTSUP: nvs_startup's "all sectors are closed, this is not a nvs fs or
# irreparably corrupted" branch. The 64 MB FlexSPI part ships with non-blank
# content at the storage partition (0x620000), so NVS sees no valid filesystem
# and refuses to clobber a region it does not recognise. Nothing to do with the
# FlexSPI driver or XIP.
#
# This lets NVS erase and initialise such a region once. Verified on silicon
# 2026-07-25 with stock samples/subsys/kvss/nvs (mounts, writes, survives reboot).
CONFIG_NVS_INIT_BAD_MEMORY_REGION=y

# Zephyr LOG on the board UART (flexcomm3 / the J-Link VCOM), separate from the
# box console on USB CDC. This is the "boot-log channel" PORTING.md describes,
# and it is not optional on a networked board: the KSZ8081 driver announces
# "PHY (2) is entering autonegotiation sequence" / "PHY 2 is up ... 100 Mb", and
# with logging off an interface that never came up is indistinguishable from a
# bad cable. That cost most of an evening on 2026-07-25.
CONFIG_LOG=y
CONFIG_LOG_MODE_MINIMAL=y
# ERRORS ONLY BY DEFAULT -- this line is load-bearing, not tidiness.
# LOG_MODE_MINIMAL is SYNCHRONOUS: it formats and writes inline, to a 115200
# baud UART. Zephyr's default level is INFO, and usbd_cdc_acm.c does
#     LOG_INF("tx_en: trigger irq_cb_work")
# inside cdc_acm_irq_tx_enable() -- i.e. ON EVERY FRAME WE SEND. With the
# default level that cost ~12 ms per frame on the box's RT service loop
# (dbg/usb_send_us 112 us -> 12,044 us; loopback 1 ms -> 86 ms), and it is
# invisible from outside: the watchdog still ticks at 1 Hz.
# Raise individual modules explicitly instead, as PHY is raised below.
CONFIG_LOG_DEFAULT_LEVEL=1
CONFIG_PHY_LOG_LEVEL_INF=y
CONFIG_ETHERNET_LOG_LEVEL_WRN=y
CONFIG_NET_L2_ETHERNET_LOG_LEVEL_WRN=y

# ENET TX descriptors. The driver defaults to ONE, so a send can stall waiting
# for the previous descriptor to free -- and our publishes are blocking sends on
# the single service loop, so that stall lands directly on the RT path.
# Measured before this change: dbg/send_us median 142, max 412 us.
# 6 matches ETH_NXP_ENET_RX_BUFFERS; the driver allows 1..16.
CONFIG_ETH_NXP_ENET_TX_BUFFERS=6

# --- diagnostic channel: Zephyr shell + net stack instrumentation ---
# The box CLI owns the USB CDC console; this is Zephyr's OWN shell on the board
# UART (flexcomm3 = the J-Link VCOM), so the two never contend. Gives `net
# stats`, `net iface`, `device list`, `ptp_clock get` -- the tools that isolated
# the PTP and link bugs -- without disturbing the box console.
CONFIG_SHELL=y
CONFIG_SHELL_BACKEND_SERIAL=y
CONFIG_NET_SHELL=y
CONFIG_DEVICE_SHELL=y
CONFIG_PTP_CLOCK_SHELL=y

# Per-packet latency accounting THROUGH the stack (driver -> net_pkt -> RX
# thread -> socket). This is how you see where recv_us actually goes instead of
# guessing at Kconfig knobs. PORTING.md A/B'd this as free on the Teensy;
# re-verify on this board rather than assuming.
CONFIG_NET_STATISTICS=y
CONFIG_NET_STATISTICS_USER_API=y
CONFIG_NET_PKT_RXTIME_STATS=y
CONFIG_NET_PKT_TXTIME_STATS=y
CONFIG_NET_PKT_RXTIME_STATS_DETAIL=y
CONFIG_NET_PKT_TXTIME_STATS_DETAIL=y

# --- IEEE-1588 PTP protocol stack (step 1 of PTP integration) ---
# CONFIG_PTP_CLOCK above only instantiates the ENET 1588 hardware counter and
# lets box_ptp.c read it free-running. CONFIG_PTP is the PROTOCOL: it makes the
# box a real PTP port that can discipline that counter to a grandmaster.
#
# Paired with ptp4l on the Pi (hardware timestamping both ends, direct cable so
# there is no switch asymmetry -- the thing that ruins PTP accuracy).
#
# NOTE this does NOT by itself put box events on dserv's timeline: dserv stamps
# from steady_clock + a fixed epoch offset, while PTP disciplines to the NIC's
# PHC, a DIFFERENT oscillator. Bridging PHC <-> dserv clock is host-side work
# (PTP_SYS_OFFSET_PRECISE), tracked separately.
CONFIG_PTP=y
CONFIG_NET_PKT_TIMESTAMP=y

# Network contexts. The default 6 is NOT enough once CONFIG_PTP is on, and the
# way it fails is nasty: sockets silently fail to open, so the box's %match
# registration lines are never accepted and it ends up PUBLISHING BUT DEAF --
# state/* keeps flowing while cmd/* never arrives, which looks like a healthy
# box. `%getmatch <box-ip> 5010` against dserv showed 1 of 3 matches landing,
# then 0 of 3, purely with timing.
#
# In use simultaneously: the dserv frame connection, the config-server listener
# on 5010, dserv's accepted connect-back, each short-lived registration
# connection, and PTP's two UDP sockets (event 319 / general 320).
# Verified 2026-07-26: at 16, all three matches register on a fresh boot and the
# downlink works.
CONFIG_NET_MAX_CONTEXTS=16
CONFIG_NET_MAX_CONN=16

# --- scheduler resolution: the limit on cross-box simultaneity ---
# k_timer timeouts are expressed in TICKS, so cmd/do/<pin>/at_abs can only fire
# on a tick boundary. At the 10000 default (100 us) each box rounds T to its own
# tick, and the two boards' tick phases are unrelated -- so two boxes told to
# fire at the SAME absolute instant land up to 100 us apart, with random sign.
#
# MEASURED on a Digilent scope, two boxes, pin 18, 40 shots: skew jumped over
# roughly +/-100 us in both directions. That is the tick, not the clocks -- PTP
# was holding +/-352 ns at the time, so ~300x of hard-won sync was being thrown
# away in the last step. A single early reading of ~7 us looked fine and was
# pure luck; only the distribution showed it.
#
# The board's OS timer counts at 1 MHz (CONFIG_SYS_CLOCK_HW_CYCLES_PER_SEC), so
# 1 us is the hardware floor. DO NOT USE IT. Tried twice; the second attempt
# pinned the mechanism:
#
#   box1  watchdog=2   (stalled 2 s after boot)   cmds_rx=0   still answers ping
#   box2  watchdog=43  (stalled 43 s after boot)  cmds_rx=1   stopped answering
#
# The watchdog publish is the 1 Hz heartbeat of the MAIN SERVICE LOOP, and it
# stopped after two ticks -- while ICMP kept working, because that is answered by
# the net stack's own threads. So the box is not crashing: its main loop is being
# STARVED, which is what a 1 MHz tick does when every K_MSEC in the stack becomes
# a 1000x larger tick count. It presents as a healthy-looking box that has quietly
# stopped doing its job, which is the worst failure shape this project has.
#
# Note it can still BOOT and register at 1 us (both boxes did, and anchored) --
# it dies seconds later. So a bring-up check alone will not catch this; watch
# state/watchdog advance for a minute.
#
# That also means the ~30 us floor below CANNOT be chased by lowering the tick on
# this platform. Isolate it with ONE box against the Pi's kernel-stamped GPIO
# input instead -- that needs no second box and no finer tick.
#
# 10 us is the value in use. It helps, but NOT by the factor the arithmetic
# suggests, and the honest numbers matter here because an eyeballed reading said
# otherwise first.
#
# Measured with host/scope_skew.py, 100 shots, 0 skipped:
#     100 us tick : +/-100 us          (tick-dominated)
#      10 us tick : +/-37 us, median |skew| 11.4 us, p90 23.8 us
# A 10x tick reduction bought ~2.7x, not 10x.
#
# And the SHAPE says the tick is no longer the mechanism at all. Pure
# quantisation would be TRIANGULAR -- each box's rounding error uniform on
# [0,tick), independent, so the difference peaks hard at zero and cuts off at
# 10 us, median |skew| ~2.9 us. What we measure is roughly FLAT out to ~21 us
# with the 0-3 us bin nearly EMPTY. That is the opposite shape.
#
# So there is a ~30 us floor from something else, and it dominates at this tick.
# The clocks are not it: PTP held box1 -196 ns / box2 +547 ns during that run,
# ~40x tighter than the skew. Suspect the fire path -- abs_fire() writes the pin
# from timer expiry, and a flat (not tailed) spread suggests it contends with
# the Ethernet RX thread on EVERY shot rather than occasionally.
#
# Do not drop the tick further expecting a win until that floor is understood;
# the cheap test is to run scope_skew.py again at 1 us and see if anything moves.
CONFIG_SYS_CLOCK_TICKS_PER_SEC=100000

# OTA step 4: the arm/confirm lifecycle (boot_request_upgrade,
# boot_write_img_confirmed, boot_is_img_confirmed). Depends on FLASH_MAP, which
# is set above. Only meaningful under MCUboot; the code using it is additionally
# gated on BOX_HAVE_OTA_SLOT, which CMake only defines for an MCUboot build.
# MCUBOOT_IMG_MANAGER lives under the IMG_MANAGER menuconfig, which requires
# STREAM_FLASH. Setting it alone is SILENTLY IGNORED -- the build succeeds and
# every arm/confirm path compiles out, so the feature simply is not there.
# Verified present in .config after building, not assumed.
CONFIG_STREAM_FLASH=y
CONFIG_IMG_MANAGER=y
CONFIG_MCUBOOT_IMG_MANAGER=y

# ---- analog input (MCP3204 on the mikroBUS socket) ----
# Zephyr's own driver, not a port of the RP2350's pico_mcp3204.h: the wire
# protocol is identical (one 3-byte transaction per channel), so a hand-rolled
# version would issue the same SPI traffic while owing us a driver to maintain.
CONFIG_SPI=y
CONFIG_ADC=y
CONFIG_ADC_MCP320X=y

# The acquisition thread's priority, set DELIBERATELY rather than inherited.
#
# The default is 0 -- the same as CONFIG_MAIN_THREAD_PRIORITY, i.e. our service
# loop. Equal priorities do not preempt, so the ADC thread cannot interrupt the
# loop, but it must then wait for the loop to yield: the loop blocks in
# box_event_wait(K_MSEC(1)), so sampling could inherit up to ~1 ms of scheduling
# latency -- exactly the period of a 1 kHz eye feed, and the worst possible
# number to leave to a default.
#
# 1 sits at the TOP of the app lattice (driver > sweep 2 > service 3 >
# publisher 4 -- see prj.conf's data-preservation note, 2026-08-02): a
# blocked adc_read must be preempted by its driver immediately. The residual jitter is recorded rather than
# removed: box_adc stamps each sweep from the box clock, which PTP keeps on
# dserv's timeline to well under a microsecond, so the host learns when each
# sample was actually taken instead of assuming a perfect cadence.
CONFIG_ADC_MCP320X_ACQUISITION_THREAD_PRIO=1

# The NXP UDC driver's internal event slab. Moved here from prj.conf on
# 2026-08-22: the symbol is defined only in drivers/usb/udc/Kconfig.mcux, so a
# non-NXP board warns on it (nRF52840 DK) or fails outright (XIAO nRF54LM20A).
# THE REASONING -- why 16, and the ~8-of-20-frames burst cliff it fixes -- is in
# prj.conf next to the UDC buf-pool note it belongs with.
CONFIG_UDC_NXP_EVENT_COUNT=16
```

## src/box_fast.h
```c
/*
 * box_fast.h -- the inbound schedule fast path (+29).
 *
 * Implemented in main.c (it owns every piece of state the handlers touch:
 * the clock, the obs epoch, the sched table, the ledger counters). Called
 * from the eth reader thread (box_net_eth.c) for every complete inbound
 * frame, at priority 2, microseconds after the bytes left the wire.
 *
 * Returns 1 when the frame was CONSUMED (one of the schedule classes --
 * cmd/do/<n>/at, cmd/timer/<t>/at, cmd/do/<n>/at_abs -- or the obs epoch
 * carrier ess/in_obs): the caller must not queue it, the service loop never
 * sees it. Returns 0 for everything else: queue it for ordinary dispatch.
 * Also counts the frame into state/cmds_rx either way, so callers on this
 * path must not count again.
 *
 * arr_us is the arrival stamp (box clock, from the reader's recv). The USB
 * path reaches the same handlers through main.c's own dispatch with
 * arr_us = processing time -- the historical conflation, unchanged there.
 */
#ifndef BOX_FAST_H
#define BOX_FAST_H

#include <stdint.h>

int box_main_fast_frame(const uint8_t *frame, uint64_t arr_us);

#endif /* BOX_FAST_H */
```
